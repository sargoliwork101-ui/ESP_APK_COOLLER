/* =========================================================================
 *  soft_aes.h  —  پیاده‌سازی نرم‌افزاری AES-128-ECB برای ESP8266
 *  این فایل فقط در صورتی کامپایل می‌شود که برد به mbedtls دسترسی نداشته باشد.
 * ========================================================================= */
#ifndef SOFT_AES_H
#define SOFT_AES_H

#include <Arduino.h>
#include <stdint.h>
#include <string.h>
#include <stdlib.h>

static const uint8_t _sbox[256] = {
  0x63,0x7c,0x77,0x7b,0xf2,0x6b,0x6f,0xc5,0x30,0x01,0x67,0x2b,0xfe,0xd7,0xab,0x76,
  0xca,0x82,0xc9,0x7d,0xfa,0x59,0x47,0xf0,0xad,0xd4,0xa2,0xaf,0x9c,0xa4,0x72,0xc0,
  0xb7,0xfd,0x93,0x26,0x36,0x3f,0xf7,0xcc,0x34,0xa5,0xe5,0xf1,0x71,0xd8,0x31,0x15,
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  0x8c,0xa1,0x89,0x0d,0xbf,0xe6,0x42,0x68,0x41,0x99,0x2d,0x0f,0xb0,0x54,0xbb,0x16 };
static const uint8_t _isbox[256] = {
  0x52,0x09,0x6a,0xd5,0x30,0x36,0xa5,0x38,0xbf,0x40,0xa3,0x9e,0x81,0xf3,0xd7,0xfb,
  0x7c,0xe3,0x39,0x82,0x9b,0x2f,0xff,0x87,0x34,0x8e,0x43,0x44,0xc4,0xde,0xe9,0xcb,
  0x54,0x7b,0x94,0x32,0xa6,0xc2,0x23,0x3d,0xee,0x4c,0x95,0x0b,0x42,0xfa,0xc3,0x4e,
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  0x17,0x2b,0x04,0x7e,0xba,0x77,0xd6,0x26,0xe1,0x69,0x14,0x63,0x55,0x21,0x0c,0x7d };
static const uint8_t _rcon[11]={0x00,0x01,0x02,0x04,0x08,0x10,0x20,0x40,0x80,0x1b,0x36};

static inline uint8_t _xt(uint8_t a){return (uint8_t)((a<<1)^((a&0x80)?0x1b:0));}
static inline uint8_t _mul(uint8_t a,uint8_t b){uint8_t r=0;for(int i=0;i<8;i++){if(b&1)r^=a;bool h=(a&0x80)!=0;a=(uint8_t)(a<<1);if(h)a^=0x1b;b>>=1;}return r;}
static void _ks(const uint8_t* k, uint8_t* rk){
  memcpy(rk,k,16);
  for(int i=1;i<=10;i++){
    uint8_t t[4]={_sbox[rk[16*i-3]],_sbox[rk[16*i-2]],_sbox[rk[16*i-1]],_sbox[rk[16*i-4]]};
    t[0]^=_rcon[i];
    for(int j=0;j<4;j++) rk[16*i+j]=rk[16*(i-1)+j]^t[j];
    for(int j=4;j<16;j++) rk[16*i+j]=rk[16*i+j-4]^rk[16*(i-1)+j];
  }
}
static void _sb(uint8_t* s){for(int i=0;i<16;i++)s[i]=_sbox[s[i]];}
static void _isb(uint8_t* s){for(int i=0;i<16;i++)s[i]=_isbox[s[i]];}
static void _sr(uint8_t* s){
  uint8_t t;
  t=s[1];s[1]=s[5];s[5]=s[9];s[9]=s[13];s[13]=t;
  t=s[2];s[2]=s[10];s[10]=t; t=s[6];s[6]=s[14];s[14]=t;
  t=s[3];s[3]=s[15];s[15]=s[11];s[11]=s[7];s[7]=t;
}
static void _isr(uint8_t* s){
  uint8_t t;
  t=s[13];s[13]=s[9];s[9]=s[5];s[5]=s[1];s[1]=t;
  t=s[2];s[2]=s[10];s[10]=t; t=s[6];s[6]=s[14];s[14]=t;
  t=s[7];s[7]=s[11];s[11]=s[15];s[15]=s[3];s[3]=t;
}
static void _mc(uint8_t* s){
  for(int c=0;c<16;c+=4){
    uint8_t a=s[c],b=s[c+1],cc=s[c+2],d=s[c+3],t=(uint8_t)(a^b^cc^d);
    s[c]  =(uint8_t)(a^t^_xt((uint8_t)(a^b)));
    s[c+1]=(uint8_t)(b^t^_xt((uint8_t)(b^cc)));
    s[c+2]=(uint8_t)(cc^t^_xt((uint8_t)(cc^d)));
    s[c+3]=(uint8_t)(d^t^_xt((uint8_t)(d^a)));
  }
}
static void _imc_col(uint8_t* w){
  uint8_t a=w[0],b=w[1],c=w[2],d=w[3];
  w[0]=_mul(a,0x0e)^_mul(b,0x0b)^_mul(c,0x0d)^_mul(d,0x09);
  w[1]=_mul(a,0x09)^_mul(b,0x0e)^_mul(c,0x0b)^_mul(d,0x0d);
  w[2]=_mul(a,0x0d)^_mul(b,0x09)^_mul(c,0x0e)^_mul(d,0x0b);
  w[3]=_mul(a,0x0b)^_mul(b,0x0d)^_mul(c,0x09)^_mul(d,0x0e);
}
static void _imc(uint8_t* s){for(int c=0;c<16;c+=4)_imc_col(s+c);}
static void _ark(uint8_t* s,const uint8_t* k){for(int i=0;i<16;i++)s[i]^=k[i];}
static void _enc(const uint8_t* in,uint8_t* out,const uint8_t* rk){
  uint8_t s[16]; memcpy(s,in,16); _ark(s,rk);
  for(int r=1;r<=9;r++){_sb(s);_sr(s);_mc(s);_ark(s,rk+16*r);}
  _sb(s);_sr(s);_ark(s,rk+160); memcpy(out,s,16);
}
static void _dec(const uint8_t* in,uint8_t* out,const uint8_t* rk){
  uint8_t s[16]; memcpy(s,in,16);
  uint8_t drk[176]; memcpy(drk,rk+160,16);
  for(int i=1;i<=9;i++){memcpy(drk+16*i,rk+16*(10-i),16);_imc(drk+16*i);}
  memcpy(drk+160,rk,16);
  _ark(s,drk);
  for(int r=1;r<=9;r++){_isr(s);_isb(s);_ark(s,drk+16*r);_imc(s);}
  _isr(s);_isb(s);_ark(s,drk+160); memcpy(out,s,16);
}
static void _ecb(const uint8_t* key,const uint8_t* in,uint8_t* out,size_t blocks,bool enc){
  uint8_t rk[176]; _ks(key,rk);
  for(size_t b=0;b<blocks;b++){
    if(enc) _enc(in+b*16,out+b*16,rk); else _dec(in+b*16,out+b*16,rk);
  }
}

static const uint8_t _KEY[16] PROGMEM = {
  0x4F,0xA1,0xC3,0x92,0x0E,0x77,0xB5,0x2D,
  0x8C,0x1A,0x6F,0xE4,0x33,0xD9,0x5B,0x88
};

static inline String softEncryptPassword(const char* p, size_t bufSize){
  if(!p||!*p) return String("");
  size_t pad=(bufSize+15)/16*16;
  uint8_t* in=(uint8_t*)calloc(pad,1); if(!in)return "";
  strncpy((char*)in,p,bufSize-1);
  uint8_t* out=(uint8_t*)calloc(pad,1); if(!out){free(in);return "";}
  _ecb(_KEY,in,out,pad/16,true);
  String r="ENC:";
  for(size_t i=0;i<pad;i++){char h[3];snprintf(h,3,"%02x",out[i]);r+=h;}
  free(in);free(out);
  return r;
}
static inline void softLoadAndDecryptPassword(const char* sv,char* out,size_t sz){
  if(!sv||!*sv){out[0]=0;return;}
  String v(sv);
  if(!v.startsWith("ENC:")){strncpy(out,sv,sz-1);out[sz-1]=0;return;}
  String hx=v.substring(4); size_t len=hx.length();
  if(len%32!=0) return;
  size_t pad=len/2;
  uint8_t* in=(uint8_t*)calloc(pad,1); if(!in) return;
  for(size_t i=0;i<pad;i++){char c[3]={hx[i*2],hx[i*2+1],0};in[i]=(uint8_t)strtol(c,nullptr,16);}
  uint8_t* ob=(uint8_t*)calloc(pad,1); if(!ob){free(in);return;}
  _ecb(_KEY,in,ob,pad/16,false);
  size_t cs=pad<sz-1?pad:sz-1; memcpy(out,ob,cs); out[cs]=0;
  free(in);free(ob);
}

#endif
